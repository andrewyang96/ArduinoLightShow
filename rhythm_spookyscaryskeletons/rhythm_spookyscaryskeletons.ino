unsigned long time;
unsigned long startTime;

// CHANGE THESE VARIABLES
int DIFFLENGTH = 4584;
int TRIGGERSLENGTH = 492;

// insert array of triggers
short triggers [492] = {140, 149, 150, 159, 168, 169, 178, 187, 188, 196, 197, 206, 215,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 4490, 4492};

int prevIndex = 0;
int index = -1;

int ledPins [7] = {12,11,10,9,8,7,6};
int multiColor [3] = {5,4,3}; // handle 8th multicolor LED
int state = 0;
int multiColorState = 0;
boolean multiColorStateArr [7][3] = {{true,false,false},
                                  {false,true,false},
                                  {false,false,true},
                                  {true,true,false},
                                  {false,true,true},
                                  {true,false,true},
                                  {true,true,true}};
/* Multicolor states:
   0: Red
   1: Green
   2: Blue
   3: Red + Green = Lime
   4: Green + Blue = Skyblue
   5: Red + Blue = Purple
   6: RGB = White
*/

void setup() {
  for (int i = 0; i < 7; i++) {
    pinMode(ledPins[i], OUTPUT); 
  }
  for (int i = 0; i < 3; i++) {
    pinMode(multiColor[i], OUTPUT);
  }
  Serial.begin(9600);
  randomSeed(analogRead(0));
}

void loop() {
  
  if (index == -1) {
    for (int i = 5; i > 0; i--) {
      Serial.println(i);
      delay(500);
    }
    index = 0;
    startTime = millis();
  }
  
  time = millis();
  prevIndex = index;
  index = ((time-startTime) / 50) % DIFFLENGTH;
  if (prevIndex != index) {
    Serial.print("Index: ");
    Serial.println(index);
  }
  
  for (int i = 0; i < TRIGGERSLENGTH; i++) {
    
    if (prevIndex != index && index == triggers[i]) {
      
      for (int i = 0; i < 7; i++) {
        if (random(2) == 0) {
          digitalWrite(ledPins[i], LOW);
        } else {
          digitalWrite(ledPins[i], HIGH);
        }
      }
      
      if (random(2) == 0) {
        for (int i = 0; i < 3; i++) {
          digitalWrite(multiColor[i], LOW);
        }
      } else {
        for (int i = 0; i < 3; i++) {
          if (random(2) == 0) {
            digitalWrite(multiColor[i], HIGH);
          }
        }
      }
      
      break;
      
    }
    
  }
  
}
